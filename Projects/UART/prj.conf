## CMakeLists.txt
```
#
# Copyright (c) 2018 Nordic Semiconductor
#
# SPDX-License-Identifier: LicenseRef-BSD-5-Clause-Nordic
#

cmake_minimum_required(VERSION 3.13.1)

find_package(Zephyr REQUIRED HINTS $ENV{ZEPHYR_BASE})
project(mqtt-simple)


# NORDIC SDK APP START
FILE(GLOB app_sources src/*.c)
target_sources(app PRIVATE ${app_sources})

# NORDIC SDK APP END
```

## Kconfig
```
#
# Copyright (c) 2020 Nordic Semiconductor ASA
#
# SPDX-License-Identifier: LicenseRef-Nordic-5-Clause
#

menu "MQTT simple sample"
config MQTT_PUB_TOPIC
	string "MQTT publish topic"
	default "dev/uoc-1/notif/notifData"

config MQTT_SUB_TOPIC
	string "MQTT subscribe topic"
	default "dev/uoc-1/notif/solParsed"

config MQTT_CLIENT_ID
	string "MQTT Client ID"
	default "uoc-1"

config MQTT_BROKER_HOSTNAME
	string "MQTT broker hostname"
	default "a2yx4i4f6mu6nh-ats.iot.eu-central-1.amazonaws.com"

config MQTT_BROKER_PORT
	int "MQTT broker port"
	default 8883
	
config MQTT_BROKER_USERNAME
	string "MQTT broker user name"
	default "wine"

config MQTT_BROKER_PASSWORD
    string "MQTT broker password"
    default "wine2020"

config MQTT_MESSAGE_BUFFER_SIZE
	int "MQTT message buffer size"
	default 1024

config MQTT_PAYLOAD_BUFFER_SIZE
	int "MQTT payload buffer size"
	default 1024

config MQTT_RECONNECT_DELAY_S
	int "Seconds to delay before attempting to reconnect to the broker."
	default 5

config LTE_CONNECT_RETRY_DELAY_S
	int "Seconds to delay before attempting to retry LTE connection."
	default 5

config MQTT_TLS_SEC_TAG
	int "TLS credentials security tag"
	default 16842753

config MQTT_TLS_SESSION_CACHING
	bool "Enable TLS session caching"

config MQTT_TLS_PEER_VERIFY
	int "Set peer verification level"
	default 1
	help
		Set to 0 for VERIFY_NONE, 1 for VERIFY_OPTIONAL, and 2 for
		VERIFY_REQUIRED.

endmenu

menu "Zephyr Kernel"
source "Kconfig.zephyr"
endmenu

module = MQTT_SIMPLE
module-str = MQTT Simple
source "${ZEPHYR_BASE}/subsys/logging/Kconfig.template.log_config"
```

## prj.conf
```kconfig
#
# Copyright (c) 2020 Nordic Semiconductor ASA
#
# SPDX-License-Identifier: LicenseRef-Nordic-5-Clause
#

# Networking
CONFIG_NETWORKING=y
CONFIG_NET_NATIVE=n
CONFIG_NET_SOCKETS_OFFLOAD=y
CONFIG_NET_SOCKETS=y
CONFIG_NET_SOCKETS_POSIX_NAMES=y

# CONFIG_LEGACY_TIMEOUT_API=y

#Date time
#CONFIG_DATE_TIME=y
#CONFIG_DATE_TIME_UPDATE_INTERVAL_SECONDS=30

# LTE link control
CONFIG_LTE_LINK_CONTROL=y
CONFIG_LTE_AUTO_INIT_AND_CONNECT=n

# Modem library
CONFIG_NRF_MODEM_LIB=y
# CONFIG_LTE_PDP_CMD=y
# CONFIG_LTE_PDP_CONTEXT="0,\"IPv4v6\",\"<orangeworld>\""

# AT Host
CONFIG_UART_INTERRUPT_DRIVEN=y
CONFIG_AT_HOST_LIBRARY=y
# CONFIG_SERIAL=y
# CONFIG_TRUSTED_EXECUTION_NONSECURE=y

# MQTT
CONFIG_MQTT_LIB=y
CONFIG_MQTT_LIB_TLS=y
CONFIG_MQTT_CLEAN_SESSION=y
CONFIG_NEWLIB_LIBC=y
CONFIG_CJSON_LIB=y

# Application
# CONFIG_MQTT_PUB_TOPIC="my/publish/topic"
# CONFIG_MQTT_SUB_TOPIC="my/subscribe/topic"
# CONFIG_MQTT_CLIENT_ID="my-client-id"
# CONFIG_MQTT_BROKER_HOSTNAME="mqtt.eclipseprojects.io"
# CONFIG_MQTT_BROKER_PORT=1883

# Button support
CONFIG_DK_LIBRARY=y

# Enable logging
CONFIG_LOG=y
CONFIG_MQTT_SIMPLE_LOG_LEVEL_DBG=y
# CONFIG_LOG_STRDUP_BUF_COUNT=16
# CONFIG_LOG_STRDUP_MAX_STRING=700

# Memory
CONFIG_MAIN_STACK_SIZE=4096
CONFIG_HEAP_MEM_POOL_SIZE=2048

# Thread configs 
# CONFIG_THREAD_NAME=y     
```

## src/main.c
```c
#include <zephyr.h>
#include <sys/printk.h>
#include <drivers/uart.h>
#include "dusty_MQTT.h"


void fsm_scheduleEvent(uint16_t delay, fsm_timer_callback cb)
{   
   // remember what function to call
   app_vars.fsmCb       = cb;
   // configure/start the timer
   k_timer_start(&fsm_timer, K_MSEC(delay), K_NO_WAIT);
}

void fsm_cancelEvent(void) 
{
   // stop the timer
   k_timer_stop(&fsm_timer);
   // clear function to call
   app_vars.fsmCb       = NULL;
}

void fsm_setCallback(fsm_reply_callback cb) 
{
   app_vars.replyCb     = cb;
}

void api_response_timeout(void) 
{
   LOG_ERR("[DUSTY_Thread] API response timeout! Reconnecting...");
   dn_ipmg_cancelTx();
   fsm_scheduleEvent(BACKOFF_AFTER_TIMEOUT,api_initiateConnect);  
}

void api_initiateConnect(void) 
{
   LOG_INF("[DUSTY_Thread] Initiating connection...");
   // issue command from Dusty API
   dn_ipmg_initiateConnect();
   // schedule timeout event
   fsm_scheduleEvent(
      SERIAL_RESPONSE_TIMEOUT,
      api_response_timeout
   );
}


void dn_ipmg_reply_cb(uint8_t cmdId) 
{
   app_vars.replyCb();
}

void api_getSystemInfo_reply(void){
  fsm_cancelEvent();
  dn_ipmg_getSystemInfo_rpt* reply;
  reply = (dn_ipmg_getSystemInfo_rpt*)app_vars.replyBuf;
  if(reply->RC == 0){
     char MAC[24];
     sprintf(MAC,"%02X:%02X:%02X:%02X:%02X:%02X:%02X:%02X", reply->macAddress[0], reply->macAddress[1], reply->macAddress[2], 
                  reply->macAddress[3], reply->macAddress[4], reply->macAddress[5], reply->macAddress[6], reply->macAddress[7]);
     LOG_INF("Hardware model: %i , Hardware Revision: %i , MAC Address: %s \n",reply->hwModel,reply->hwRev,log_strdup(MAC));
  }
}

void api_getSystemInfo(void){
  fsm_setCallback(api_getSystemInfo_reply);
  dn_ipmg_getSystemInfo((dn_ipmg_getSystemInfo_rpt*)(app_vars.replyBuf));
  fsm_scheduleEvent(SERIAL_RESPONSE_TIMEOUT, api_response_timeout);
}

void dn_ipmg_status_cb(uint8_t newStatus) 
{
   switch (newStatus) {
      case DN_SERIAL_ST_CONNECTED:
         //cancel the api_response_timeout event once connected
         fsm_cancelEvent();
         LOG_INF("[DUSTY_Thread] CONNECTED succesfully!");
         // schedule next event
         fsm_scheduleEvent(
            INTER_FRAME_PERIOD,
            api_getSystemInfo
         );
         break;
      case DN_SERIAL_ST_DISCONNECTED:
         LOG_ERR("[DUSTY_Thread] DISCONNECTED! Reconnecting...");
         // schedule first event to reconnect with the dusty manager
         fsm_scheduleEvent(
            INTER_FRAME_PERIOD,
            api_initiateConnect
         );
         break;
      default:
         // nothing to do
         break;
   }
}

void timer_interrupt(struct k_timer *dummy)
{
   //Call the callback function set in fsm_scheduleEvent()
   app_vars.fsmCb();
}


void main()
{
   memset(&app_vars, 0, sizeof(app_vars));
   // initialize the ipmg module
   dn_ipmg_init(
      NULL,                            // notifCb
      NULL,                            // notifBuf
      0,                               // notifBufLen
      dn_ipmg_reply_cb,                // replyCb
      dn_ipmg_status_cb                // statusCb
   );
   fsm_scheduleEvent(CMD_PERIOD, &api_initiateConnect);
}
```

## src/data_buff.c
```c
/*
 * Wireless Networks Research Lab @ UOC
 * Author: Aaron Acosta
 * Date: 11/12/2020
 * License: BSD
 */

#include "data_buff.h"

void init_data_buffer(){
  k_mutex_lock(&my_mutex, K_FOREVER);
  int i;
  for (i=0; i < MAX_DATA_BUF_LENGTH; ++i){
    data_buffer[i].used = 0;
  }
  k_mutex_unlock(&my_mutex);
}

data_buf_item_t* store_to_data_buffer(uint8_t* src_data, size_t len){
  //lock mutex
  k_mutex_lock(&my_mutex, K_FOREVER);
  uint8_t i = 0;
  uint8_t is_free = 0;
  while(i < MAX_DATA_BUF_LENGTH && is_free == 0){
    if (data_buffer[i].used == 0){
      is_free = 1;
    } 
    else {
      ++i;
    }
  }
  if (i == MAX_DATA_BUF_LENGTH){
    //Data buffer is FULL
    k_mutex_unlock(&my_mutex);
    return (data_buf_item_t*) NULL;
  }
  else {
    data_buffer[i].used = 1;
    memcpy(data_buffer[i].data, src_data, len);
    data_buffer[i].len = len;
    k_mutex_unlock(&my_mutex);
    return &data_buffer[i];
  }
}

void free_data_buffer_item(data_buf_item_t* item){
   //lock mutex
   k_mutex_lock(&my_mutex, K_FOREVER);
   item->used = 0;
   memset(item->data, 0, item->len);
   k_mutex_unlock(&my_mutex);
   //unlock mutex
}
```

## src/dusty_MQTT.h
```c
/*
 * Wireless Networks Research Lab @ UOC
 * Author: Aaron Acosta
 * Date: 11/12/2020
 * License: BSD
 */

#ifndef dusty_MQTT
#define dusty_MQTT

#include <drivers/uart.h>
#include <stdio.h>
#include <stdlib.h>
#include <string.h>
#include <zephyr.h>
#include <errno.h>
#include <math.h>
#include <time.h>
#include <date_time.h>
#include <random/rand32.h>

#include "dn_ipmg.h"
#include "dn_serial_mg.h"
#include "dn_uart.h"
#include "data_buff.h"
#include <modem/lte_lc.h>
#include <net/mqtt.h>
#include <net/socket.h>
#include <logging/log.h>
#include <cJSON.h>

//=========================== defines =========================================

#define STACKSIZE 2048
#define SUCCESS 0
#define ENDSTR 0
#define THREAD_NAME_LEN 32

//Message Queue defines
#define MAX_MSGQ_LEN MAX_DATA_BUF_LENGTH
#define MSGQ_WAITING_PERIOD 10 //ms

//threads priorities
#define PRIORITY_MQTT -3 //the lower the number is, the higher priority is
#define PRIORITY_DUSTY -3

//threads delays (in ms)
#define MQTT_THREAD_DELAY  5000
#define DUSTY_THREAD_DELAY 0

//DUSTY THREAD
#define CMD_PERIOD 1000                  
#define BACKOFF_AFTER_TIMEOUT 0   
#define SERIAL_RESPONSE_TIMEOUT 40 
#define INTER_FRAME_PERIOD 0

//subscription
#define SUBSC_FILTER_DATA 0x10
#define UNSUBSC_ALL 0x00

//MQTT THREAD
#define MQTT_PUBLISH_FLAG 0
#define MQTT_SUBSCRIPTION_COUNT 1
#define MQTT_SUBSCRIPTION_MSG_ID 1
#define MQTT_DATA_PUBLISHING_MAX_RETRIES 3
#define MQTT_POLL_TIMEOUT 5000 //ms
#define MQTT_SENDING_PERIOD 100 //ms
#define MQTT_USERNAME "wine"
#define MQTT_PASS "wine2020"

//PAYLOAD DATA DEFINE's
#define MAC_ADDR_SIZE 24
#define TIMESTAMP_STR_SIZE 16
#define GATEWAY_NAME "uoc-1"


LOG_MODULE_REGISTER(app);

static K_MUTEX_DEFINE(my_mutex_2);
//=========================== typedef =========================================

//=== callback signature
typedef void (*fsm_timer_callback)(void);
typedef void (*fsm_reply_callback)(void);

// msg queue item
typedef struct { 
  data_buf_item_t* data;
} msgq_item_t; //size must be power of 2

typedef struct {
  // fsm
  fsm_timer_callback fsmCb;
  // reply
  fsm_reply_callback replyCb;
  // api
  uint8_t replyBuf[MAX_FRAME_LENGTH]; // holds notifications from ipmg
  uint8_t notifBuf[MAX_FRAME_LENGTH]; // notifications buffer internal to ipmg
} app_vars_t;


//data struct to let an MQTT client know the packet sending and receiving statistics 
struct mqtt_stats{
  int n_pkt_tx; //num of packets transmitted from the MQTT Client to the dusty
  int n_pkt_rx; //num of packets received from the dusty to MQTT Client
};


//====================== complex data structures ==============================

//msg_queue_name, msg_q_item_size, num_max_items, align
K_MSGQ_DEFINE(Dusty_to_MQTT_msg_q, sizeof(msgq_item_t), MAX_MSGQ_LEN, sizeof(msgq_item_t));
K_MSGQ_DEFINE(MQTT_to_Dusty_msg_q, sizeof(msgq_item_t), MAX_MSGQ_LEN, sizeof(msgq_item_t));

//=========================== variables =======================================


// Buffers for MQTT client.
static uint8_t rx_buffer[CONFIG_MQTT_MESSAGE_BUFFER_SIZE];
static uint8_t tx_buffer[CONFIG_MQTT_MESSAGE_BUFFER_SIZE];
static uint8_t payload_buf[CONFIG_MQTT_PAYLOAD_BUFFER_SIZE];
// The mqtt client struct
static struct mqtt_client client;
// MQTT Broker details.
static struct sockaddr_storage broker;
// Connected flag 
static bool connected;
// File descriptor 
static struct pollfd fds;
static struct mqtt_stats stats;
// Broker user name and password 
static struct mqtt_utf8 password;
static struct mqtt_utf8 user_name;

//Dusty thread app vars
app_vars_t app_vars;


//=========================== prototypes ======================================


//Dusty thread prototypes
int   Dusty_thread            (void);
void  dn_ipmg_notif_cb        (uint8_t cmdId, 
                               uint8_t subCmdId);
void  dn_ipmg_reply_cb        (uint8_t cmdId);
void  dn_ipmg_status_cb       (uint8_t newStatus);
void  fsm_scheduleEvent       (uint16_t delay, 
                               fsm_timer_callback cb);
void  fsm_cancelEvent         (void);
void  fsm_setCallback         (fsm_reply_callback cb);
void  api_response_timeout    (void);
void  api_initiateConnect     (void);
void  api_subscribe           (void);
void  api_subscribe_reply     (void);
void  timer_interrupt         (struct k_timer *dummy);

//MQTT thread prototypes
void  MQTT_thread             (void);
void  broker_init             (void);
void  client_init             (struct mqtt_client *client);
int   fds_init                (struct mqtt_client *c);
int   data_publish            (struct mqtt_client *c, 
                               enum mqtt_qos qos,
                               uint8_t *data,
                               size_t len);
int   subscribe               (void);
int   publish_get_payload     (struct mqtt_client *c,
                               size_t length);
void  mqtt_evt_handler        (struct mqtt_client *const c,
                               const struct mqtt_evt *evt);
void  modem_configure         (void);
void  app_mqtt_connect        (void);
inline void  set_client_username_pass(void);

//Helper fuctions
void  comm_DS_error_handling  (k_tid_t thread_id,
                               int err_code);
void convert_dusty_pkt_to_string(char* name, dn_ipmg_notifData_nt* notifData, char* pkt_str, size_t pkt_str_len);
//timer for fsm
K_TIMER_DEFINE(fsm_timer, timer_interrupt, NULL);

#endif
```
