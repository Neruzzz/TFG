## prj.conf
```kconfig
# nothing here
#UART_1 -> VCOM2 -> nRF91_APP2
#UART_0 -> VCOM0 -> nRF91_APP1
CONFIG_BOARD_NRF9160DK_UART1_ARDUINO=y
CONFIG_BOARD_NRF9160DK_UART0_ARDUINO=n
```

## src/main.c
```c
#include <zephyr.h>
#include <sys/printk.h>

void main(void)
{
	printk("UART_1 successfully routed to GPIO pins!\n");
}
```
